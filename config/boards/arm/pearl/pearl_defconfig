## config/boards/arm/pearl/pearl_defconfig
```kconfig
# SPDX-License-Identifier: MIT

CONFIG_SOC_SERIES_NRF52X=y
CONFIG_SOC_NRF52840_QIAA=y

CONFIG_BUILD_OUTPUT_UF2=y

# Enable MPU
CONFIG_ARM_MPU=y

CONFIG_PINCTRL=y

# Enable GPIO
CONFIG_GPIO=y

CONFIG_USE_DT_CODE_PARTITION=y

CONFIG_MPU_ALLOW_FLASH_WRITE=y
CONFIG_NVS=y
CONFIG_SETTINGS_NVS=y
CONFIG_FLASH=y
CONFIG_FLASH_PAGE_LAYOUT=y
CONFIG_FLASH_MAP=y
CONFIG_CLOCK_CONTROL_NRF_K32SRC_RC=y

# Enable encoder
CONFIG_EC11=n
CONFIG_EC11_TRIGGER_GLOBAL_THREAD=n

# CONFIG_ZMK_USB_LOGGING=n
# CONFIG_SENSOR_LOG_LEVEL_DBG=n

# Enable underglow
CONFIG_ZMK_RGB_UNDERGLOW=y
CONFIG_WS2812_STRIP=y
CONFIG_ZMK_RGB_UNDERGLOW_ON_START=y

# Enable more power
CONFIG_BT_CTLR_TX_PWR_PLUS_8=y

# Enable deep sleep. Timeout is in ms, 900000 is 15 minutes.
# Battery level is shown after waking from deep sleep.
CONFIG_ZMK_SLEEP=n
CONFIG_ZMK_IDLE_SLEEP_TIMEOUT=900000
```
